## conf/distro/ccd.conf
```bitbake
require conf/distro/voltumna.conf

DISTRO_NAME = "CCD"
SDK_VENDOR = "-ccdsdk"
TARGET_VENDOR = "-ccd"

# Necessary to add lapack
FORTRAN:forcevariable = ",fortran"
RUNTIMETARGET:append:pn-gcc-runtime = " libquadmath"

# complete_grub_bootloader_conf (IMAGE_PREPROCESS_COMMAND, run inside
# do_image) reads ${DEPLOY_DIR_IMAGE}/grub.cfg: EXTRA_IMAGEDEPENDS only
# covers do_image_complete:do_populate_sysroot, so the explicit ordering on
# do_deploy is needed too.
do_image[depends] += "grub-bootconf:do_deploy"
```

## conf/machine/d-6244-x11dph-t-fast.conf
```bitbake
require conf/machine/d-6244-x11dph-t.conf
MACHINEOVERRIDES =. "fast:d-6244-x11dph-t:"
```

## conf/machine/d-6244-x11dph-t-rnm.conf
```bitbake
require d-6244-x11dph-t.conf
MACHINEOVERRIDES =. "rnm:d-6244-x11dph-t:"

RNM_NETIF = "eno8403"
RNM_LCORE = "23"
```

## conf/machine/d-6346-06v45n-fast.conf
```bitbake
require conf/machine/d-6346-06v45n.conf
MACHINEOVERRIDES =. "fast:d-6346-06v45n:"
```

## conf/machine/s-d1718t-x12sdv-4c-sp6f-fast.conf
```bitbake
require conf/machine/s-d1718t-x12sdv-4c-sp6f.conf
MACHINEOVERRIDES =. "fast:s-d1718t-x12sdv-4c-sp6f:"
```
