## conf/machine/s-9124-h13ssw.conf
```bitbake
#@TYPE: Machine
#@NAME: CloudDC A+ Server AS -1115CS-TNR
#@DESCRIPTION: Machine configuration for the https://www.supermicro.com/en/products/system/clouddc/1u/as%20-1115cs-tnr machine

require include/tune-zen4.inc

MACHINEOVERRIDES =. "intel-x86-common:d-9124:h13ssw:"

IMAGE_FSTYPES = "tar"

PRIMARY_NETIF = "enp0s2f0"
ROOT = "root=/dev/vda2"

EXTRA_IMAGEDEPENDS += "grub-efi grub-bootconf"
PREFERRED_PROVIDER_virtual/bootloader = "grub-efi"

MACHINE_EXTRA_RRECOMMENDS:remove = "linux-firmware"
IMAGE_INSTALL:remove = "kernel-devicetree"
MACHINE_EXTRA_RRECOMMENDS:append = " intel-ethernet-550-firmware \
	intel-ethernet-700-firmware intel-ethernet-810-firmware"

COMPATIBLE_MACHINE:pn-dpdk = "${MACHINE}"
COMPATIBLE_MACHINE:pn-nativesdk-dpdk = "(.*)"

MACHINEOVERRIDES =. "amd:amdx86:"
PREFERRED_PROVIDER_virtual/kernel = "linux-yocto"
KERNEL_IMAGETYPE = "bzImage"
```

## conf/machine/s-d1718t-x12sdv-4c-sp6f-rnm.conf
```bitbake
require conf/machine/s-d1718t-x12sdv-4c-sp6f.conf
MACHINEOVERRIDES =. "rnm:s-d1718t-x12sdv-4c-sp6f:"

RNM_NETIF = "eno2"
RNM_LCORE = "7"
```

## conf/machine/s-x6425e-a3sev-4c-ln4-rnm.conf
```bitbake
require conf/machine/s-x6425e-a3sev-4c-ln4.conf
MACHINEOVERRIDES =. "rnm:s-x6425e-a3sev-4c-ln4:"

RNM_NETIF = "eno4"
RNM_LCORE = "3"
```

## conf/machine/ssg-6039p-e1cr16h-myricom.conf
```bitbake
#@TYPE: Machine
#@NAME: Customized Supermicro SSG-6039P-E1CR16H
#@DESCRIPTION: Machine configuration for customized Supermicro SSG-6039P-E1CR16H (64-bit)
#
#require include/intel-common.inc
#require include/tune-cascadelake.inc
#
#IMAGE_FSTYPES = "tar"
#
#PRIMARY_NETIF = "enp26s0f0"
#ROOT = "/dev/sda2"
#
#EXTRA_IMAGEDEPENDS += "grub-efi"
#
#WKS_FILE = "grub-bootdisk-microcode.wks.in"
#
#MACHINE_EXTRA_RRECOMMENDS_remove = "linux-firmware"
#MACHINE_EXTRA_RRECOMMENDS_append = " numactl kernel-module-myricom-mva libemergent"
#
#OPENBLAS_TARGET = "SKYLAKEX"

require conf/machine/ssg-6039p-e1cr16h.conf
MACHINE_EXTRA_RRECOMMENDS_append = " kernel-module-myricom-mva libemergent"
MACHINEOVERRIDES =. "ssg-6039p-e1cr16h:"
```

## conf/machine/sys-5019p-wtr-gph.conf
```bitbake
#@TYPE: Machine
#@NAME: Customized Supermicro SYS-5019P-WTR
#@DESCRIPTION: Machine configuration for customized Supermicro SYS-5019P-WTR (64-bit)
#
#require include/intel-common.inc
#require include/tune-cascadelake.inc
#
#IMAGE_FSTYPES = "tar"
#
#PRIMARY_NETIF = "enp26s0f0"
#ROOT = "/dev/sda2"
#
#EXTRA_IMAGEDEPENDS += "grub-efi"
#
#WKS_FILE = "grub-bootdisk-microcode.wks.in"
#
#MACHINE_EXTRA_RRECOMMENDS_remove = "linux-firmware"
#
#OPENBLAS_TARGET = "SKYLAKEX"

require conf/machine/sys-5019p-wtr.conf
MACHINEOVERRIDES =. "sys-5019p-wtr:"

RNM_NETIF = "0000:1a:00.1"
```

## conf/machine/up-whl01-gph.conf
```bitbake
#@TYPE: Machine
#@NAME: UP-Board Xtreme Celeron 4305UE (UPX-WHLCR-A20-04064)
#@DESCRIPTION: Machine configuration for UP-Board Xtreme Celeron 4305UE UPX-WHLCR-A20-04064 (64-bit)
#
#require include/intel-common.inc
#require include/tune-skylake.inc
#
#IMAGE_FSTYPES = "tar wic wic.bmap"
#
#PRIMARY_NETIF = "enp1s0f0"
#ROOT = "/dev/sda2"
#
#EXTRA_IMAGEDEPENDS += "grub-efi"
#
#WKS_FILE = "grub-bootdisk-microcode.wks.in"
#
#MACHINE_EXTRA_RRECOMMENDS_remove = "linux-firmware"
#MACHINE_EXTRA_RRECOMMENDS_append = " gcc-arm-none-eabi opencl-icd-loader opencl-clang dpdk"
#
#OPENBLAS_TARGET = "HASWELL"
#
require conf/machine/up-whl01.conf
MACHINEOVERRIDES =. "up-whl01:"

RNM_NETIF = "0000:01:00.0"
```
