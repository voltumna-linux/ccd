## conf/machine/d-6244-x11dph-t-gph.conf
```bitbake
require conf/machine/d-6244-x11dph-t.conf
MACHINEOVERRIDES =. "d-6244-x11dph-t:"

RNM_NETIF = "eno2"
```

## conf/machine/d-6346-06v45n-gph.conf
```bitbake
require conf/machine/d-6346-06v45n.conf
MACHINEOVERRIDES =. "d-6346-06v45n:"

RNM_NETIF = "0000:1a:00.1"
```

## conf/machine/d-6346-06v45n-rnm.conf
```bitbake
require conf/machine/d-6346-06v45n.conf
MACHINEOVERRIDES =. "rnm:d-6346-06v45n:"

RNM_NETIF = "eno8403"
RNM_LCORE = "62"
```

## conf/machine/d-9755-h14dsh-fast.conf
```bitbake
require conf/machine/d-9755-h14dsh.conf
MACHINEOVERRIDES =. "fast:d-9755-h14dsh:"
```

## conf/machine/d-9755-h14dsh.conf
```bitbake
#@TYPE: Machine
#@NAME: unknown
#@DESCRIPTION: Machine configuration for a dual socket 9755 AMD processor on Server e-Pro 2126HS-TN (64-bit)

require include/turin.inc

MACHINEOVERRIDES =. "d-9755:h14dsh:"

IMAGE_FSTYPES = "tar"

PRIMARY_NETIF = "enp17s0f0np0"
ROOT = "/dev/sda2"

EXTRA_IMAGEDEPENDS += "grub-efi grub-bootconf"
PREFERRED_PROVIDER_virtual/bootloader = "grub-efi"

MACHINE_EXTRA_RRECOMMENDS:remove = "linux-firmware"
MACHINE_EXTRA_RRECOMMENDS:append = " bios intel-ethernet-550-firmware \
	intel-ethernet-700-firmware intel-ethernet-810-firmware"

OPENBLAS_TARGET = "ZEN"

COMPATIBLE_MACHINE:pn-dpdk = "d-9755-h14dsh"
COMPATIBLE_MACHINE:pn-nativesdk-dpdk = "(.*)"
```

## conf/machine/d-e52637v3-x10drw-i-rnm.conf
```bitbake
require conf/machine/d-e52637v3-x10drw-i.conf
require conf/machine/include/common-pkgarch.inc
MACHINEOVERRIDES =. "rnm:d-e52637v3-x10drw-i:"

RNM_NETIF = "eno2"
RNM_LCORE = "11"
```

## conf/machine/d-e52637v4-x10dru-iplus-gph.conf
```bitbake
require conf/machine/d-e52637v4-x10dru-iplus.conf
MACHINEOVERRIDES =. "d-e52637v4-x10dru-iplus:"

RNM_NETIF = "enp2s0f0"
RNM_LCORE = "17"
```

## conf/machine/d-e52637v4-x10dru-iplus-rnm.conf
```bitbake
require conf/machine/d-e52637v4-x10dru-iplus.conf
require conf/machine/include/common-pkgarch.inc
MACHINEOVERRIDES =. "rnm:d-e52637v4-x10dru-iplus:"

RNM_NETIF = "enp2s0f0"
RNM_LCORE = "17"
```

## conf/machine/d-e52643v4-x10dru-i+-gph.conf
```bitbake
require conf/machine/d-e52643v4-x10dru-i+.conf
MACHINEOVERRIDES =. "d-e52643v4-x10dru-i+:"

RNM_NETIF = "eth1"
```

## conf/machine/d-e52643v4-x10dru-iplus-gph.conf
```bitbake
require conf/machine/d-e52643v4-x10dru-iplus.conf
MACHINEOVERRIDES =. "d-e52643v4-x10dru-iplus:"

RNM_NETIF = "enp2s0f0"
RNM_LCORE = "17"
```

## conf/machine/d-e52643v4-x10dru-iplus-rnm.conf
```bitbake
require conf/machine/d-e52643v4-x10dru-iplus.conf
MACHINEOVERRIDES =. "rnm:d-e52643v4-x10dru-iplus:"

RNM_NETIF = "enp1s0f1"
RNM_LCORE = "17"
```

## conf/machine/d-e5462-x7dwu-gph.conf
```bitbake
require conf/machine/d-e5462-x7dwu.conf
MACHINEOVERRIDES =. "d-e5462-x7dwu:"

RNM_NETIF = "enp7s0f0"
RNM_LCORE = "7"
```

## conf/machine/d-e5462-x7dwu-rnm.conf
```bitbake
require conf/machine/d-e5462-x7dwu.conf
MACHINEOVERRIDES =. "rnm:d-e5462-x7dwu:"

RNM_NETIF = "enp1s0f0"
RNM_LCORE = "7"
```

## conf/machine/d-e5472-x7dwu-rnm.conf
```bitbake
require conf/machine/d-e5472-x7dwu.conf
MACHINEOVERRIDES =. "rnm:d-e5472-x7dwu:"

RNM_NETIF = "enp1s0f0"
RNM_LCORE = "7"
```

## conf/machine/include/tune-zen4.inc
```bitbake
# Settings for the GCC(1) cpu-type "znver4":
#
#	AMD Family 19h core based CPUs with x86-64 instruction set support. 
#	(This supersets BMI, BMI2, CLWB, F16C, FMA, FSGSBASE, AVX,  AVX2,  ADCX,  RDSEED,  MWAITX,  SHA,
#	CLZERO,  AES,  PCLMUL,  CX16,  MOVBE, MMX, SSE, SSE2, SSE3, SSE4A, SSSE3, SSE4.1, SSE4.2, ABM,
#	XSAVEC, XSAVES, CLFLUSHOPT, POPCNT, RDPID, WBNOINVD, PKU, VPCLMULQDQ, VAES, AVX512F, AVX512DQ,
#	AVX512IFMA, AVX512CD, AVX512BW, AVX512VL, AVX512BF16, AVX512VBMI, AVX512VBMI2, AVX512VNNI,
#	AVX512BITALG, AVX512VPOPCNTDQ, GFNI and 64-bit instruction set extensions.)
#
# This tune is recommended for AMD Zen4 CPU (and beyond).
#
DEFAULTTUNE ?= "zen4"

# 
require conf/machine/include/tune-zen3.inc

# Extra tune features
TUNEVALID[zen4] = "Enable AMD x86 (64 bit) Zen 4 Core Architecture specific optimizations"
TUNE_CCARGS .= "${@bb.utils.contains('TUNE_FEATURES', 'zen4', ' -march=znver4 -mtune=znver4 ${ADDITIONAL_ISA}', '', d)}"
TUNECONFLICTS[zen4] = "m32 mx32"

# Extra tune selections
AVAILTUNES += "zen4"
TUNE_FEATURES:tune-zen4 = "${TUNE_FEATURES:tune-x86-64} zen4"
BASE_LIB:tune-zen4  = "lib64"
TUNE_PKGARCH:tune-zen4 = "zen4"
PACKAGE_EXTRA_ARCHS:tune-zen4 = "${PACKAGE_EXTRA_ARCHS:tune-zen3} zen4"
QEMU_EXTRAOPTIONS_zen4 = " -cpu EPYC,check=false"

OPENBLAS_TARGET = "ZEN"

ADDITIONAL_ISA = "${@bb.utils.contains('MACHINE_FEATURES', 'highly-optimized', '', ' ${ADVANCED_ISA}', d)}"
ADVANCED_ISA = " \
-mno-avx \
-mno-avx2 \
-mno-avx512f \
-mno-avx512cd \
-mno-avx512dq \
-mno-avx512bw \
-mno-avx512vl \
-mno-avx512ifma \
-mno-avx512vbmi \
-mno-avx512vbmi2 \
-mno-avx512vnni \
-mno-avx512bitalg \
-mno-avx512vpopcntdq \
"
```

## conf/machine/include/tune-zen5.inc
```bitbake
# Settings for the GCC(1) cpu-type "znver5":
#
#	AMD Family 1ah core based CPUs with x86-64 instruction set support.
#	(This supersets BMI, BMI2, CLWB, F16C, FMA, FSGSBASE, AVX, AVX2, ADCX, RDSEED, MWAITX, SHA,
#	CLZERO, AES, PCLMUL, CX16, MOVBE, MMX, SSE, SSE2, SSE3, SSE4A, SSSE3, SSE4.1, SSE4.2, ABM,
#	XSAVEC, XSAVES, CLFLUSHOPT, POPCNT, RDPID, WBNOINVD, PKU, VPCLMULQDQ, VAES, AVX512F, AVX512DQ,
#	AVX512IFMA, AVX512CD, AVX512BW, AVX512VL, AVX512BF16, AVX512VBMI, AVX512VBMI2, AVX512VNNI,
#	AVX512BITALG, AVX512VPOPCNTDQ, GFNI, AVXVNNI, MOVDIRI, MOVDIR64B, AVX512VP2INTERSECT,
#	PREFETCHI and 64-bit instruction set extensions.)
#
# This tune is recommended for AMD Zen5 CPU (and beyond).
#
DEFAULTTUNE ?= "zen5"

# 
require conf/machine/include/tune-zen4.inc

# Extra tune features
TUNEVALID[zen5] = "Enable AMD x86 (64 bit) Zen 5 Core Architecture specific optimizations"
TUNE_CCARGS .= "${@bb.utils.contains('TUNE_FEATURES', 'zen5', ' -march=znver5 -mtune=znver5 ${ADDITIONAL_ISA}', '', d)}"
TUNECONFLICTS[zen5] = "m32 mx32"

# Extra tune selections
AVAILTUNES += "zen5"
TUNE_FEATURES:tune-zen5 = "${TUNE_FEATURES:tune-x86-64} zen5"
BASE_LIB:tune-zen5  = "lib64"
TUNE_PKGARCH:tune-zen5 = "zen5"
PACKAGE_EXTRA_ARCHS:tune-zen5 = "${PACKAGE_EXTRA_ARCHS:tune-zen4} zen5"
QEMU_EXTRAOPTIONS_zen5 = " -cpu EPYC,check=false"

OPENBLAS_TARGET = "ZEN"

ADDITIONAL_ISA = "${@bb.utils.contains('MACHINE_FEATURES', 'highly-optimized', '', ' ${ADVANCED_ISA}', d)}"
ADVANCED_ISA = " \
-mno-avx \
-mno-avx2 \
-mno-avx512f \
-mno-avx512cd \
-mno-avx512dq \
-mno-avx512bw \
-mno-avx512vl \
-mno-avx512ifma \
-mno-avx512vbmi \
-mno-avx512vbmi2 \
-mno-avx512vnni \
-mno-avx512bitalg \
-mno-avx512vpopcntdq \
"
```

## conf/machine/include/turin.inc
```bitbake
#@TYPE: Machine
#@NAME: Turin

#@DESCRIPTION: Machine configuration for Turin systems

require conf/machine/include/tune-zen4.inc
require conf/machine/include/uart.inc

MACHINEOVERRIDES =. "amd:amdx86:turin:"
ALLOW_EMPTY:${KERNEL_PACKAGE_NAME}-devicetree = "1"
MACHINE_FEATURES += "efi"
EFI_PROVIDER = ""
WKS_FILE ?= "grub-bootdisk.wks"
QEMU_EXTRAOPTIONS_zen5 = " -cpu EPYC"

PREFERRED_PROVIDER_virtual/kernel ?= "linux-yocto-epyc"
MACHINE_EXTRA_RRECOMMENDS:append = " kernel-modules linux-firmware"
```

## conf/machine/s-4125r-x11spw-tf-gph.conf
```bitbake
require conf/machine/s-4125r-x11spw-tf.conf
MACHINEOVERRIDES =. "s-4125r-x11spw-tf:"

RNM_NETIF = "0000:1a:00.1"
```

## conf/machine/s-4125r-x11spw-tf-myricom.conf
```bitbake
require conf/machine/s-4125r-x11spw-tf.conf
MACHINE_EXTRA_RRECOMMENDS_append = " kernel-module-myricom-mva libemergent"
MACHINEOVERRIDES =. "s-4125r-x11spw-tf:"

RNM_NETIF = "eno2"

COMPATIBLE_MACHINE:pn-nativesdk-dpdk = "(.*)"
```

## conf/machine/s-4125r-x11spw-tf-rnm.conf
```bitbake
require conf/machine/s-4125r-x11spw-tf.conf
MACHINEOVERRIDES =. "rnm:s-4125r-x11spw-tf:"

RNM_NETIF = "eno2"
RNM_LCORE = "15"
```

## conf/machine/s-4305ue-up-whl01-gph.conf
```bitbake
require conf/machine/s-4305ue-up-whl01.conf
MACHINEOVERRIDES =. "s-4305ue-up-whl01:"

# RNM_NETIF = ""
# RNM_LCORE = ""
```

## conf/machine/s-4305ue-up-whl01-rnm.conf
```bitbake
require conf/machine/s-4305ue-up-whl01.conf
require conf/machine/include/common-pkgarch.inc
MACHINEOVERRIDES =. "rnm:s-4305ue-up-whl01:"

RNM_NETIF = "enp1s0"
RNM_LCORE = "1"
```

## conf/machine/s-9124-h13ssw-rnm.conf
```bitbake
require s-9124-h13ssw.conf
MACHINEOVERRIDES =. "rnm:s-9124-h13ssw:"

RNM_NETIF = "eno2"
RNM_LCORE = "7"
```
